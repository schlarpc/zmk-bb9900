## Kconfig
```kconfig
# SPDX-License-Identifier: MIT

rsource "drivers/input/Kconfig"

DT_CHOSEN_LAYER_INDICATOR := zitaotech,layer-indicator
DT_CHOSEN_TRACKPAD_INDICATOR := zitaotech,trackpad-indicator

menuconfig ZMK_BB9900_LAYER_INDICATOR
    bool "Layer indicator LED (big button backlight)"
    default $(dt_chosen_enabled,$(DT_CHOSEN_LAYER_INDICATOR))
    select LED

if ZMK_BB9900_LAYER_INDICATOR

config ZMK_BB9900_LAYER_INDICATOR_BRT
    int "Brightness on layer 1 (SYM), in percent"
    range 1 100
    default 100

config ZMK_BB9900_LAYER_INDICATOR_CYCLE_MAX_BRT
    int "Maximum brightness of the breathing (layer 2) and blinking (layer 3) effects, in percent"
    range 1 100
    default 100

config ZMK_BB9900_LAYER_INDICATOR_CYCLE_MIN_BRT
    int "Minimum brightness of the breathing (layer 2) and blinking (layer 3) effects, in percent"
    range 0 100
    default 20

config ZMK_BB9900_LAYER_INDICATOR_CYCLE_STEP
    int "Brightness change per breathing step, in percent"
    range 1 100
    default 5

config ZMK_BB9900_LAYER_INDICATOR_CYCLE_INTERVAL
    int "Milliseconds between breathing steps"
    default 20

config ZMK_BB9900_LAYER_INDICATOR_BLINK_INTERVAL
    int "Milliseconds between blink toggles"
    default 300

endif # ZMK_BB9900_LAYER_INDICATOR

menuconfig ZMK_BB9900_TRACKPAD_INDICATOR
    bool "Trackpad backlight as a layer indicator"
    default $(dt_chosen_enabled,$(DT_CHOSEN_TRACKPAD_INDICATOR))
    select LED

if ZMK_BB9900_TRACKPAD_INDICATOR

config ZMK_BB9900_TRACKPAD_INDICATOR_LAYER
    int "Layer that lights the trackpad backlight (the scroll mode layer)"
    default 3

config ZMK_BB9900_TRACKPAD_INDICATOR_BRT
    int "Brightness while that layer is active, in percent"
    range 1 100
    default 100

endif # ZMK_BB9900_TRACKPAD_INDICATOR

config ZMK_BB9900_SCROLL_CURVE
    bool "Input processor that turns trackpad motion into scrolling"
    default y
    depends on DT_HAS_ZITAOTECH_INPUT_PROCESSOR_SCROLL_CURVE_ENABLED
    depends on ZMK_POINTING

config ZMK_BB9900_SCROLL_RESOLUTION
    bool "Per-output toggle between smooth and whole-notch scrolling"
    default y
    depends on DT_HAS_ZITAOTECH_BEHAVIOR_SCROLL_RESOLUTION_ENABLED
    depends on ZMK_POINTING_SMOOTH_SCROLLING

config ZMK_BB9900_USB_SUSPEND_IS_UNPLUGGED
    bool "Treat a suspended USB bus as unplugged"
    default y if BOARD_BB9900
    depends on ZMK_USB
    help
      The BB9900 charging circuit back-feeds the battery onto VBUS, so unplugging the cable
      never produces a USB disconnect, only a bus suspend. Without this, ZMK thinks USB power
      is present and never enters deep sleep.

config ZMK_BB9900_SCROLL_RESOLUTION
    bool "Per-output toggle between smooth and whole-notch scrolling"
    default y
    depends on DT_HAS_ZITAOTECH_BEHAVIOR_SCROLL_RESOLUTION_ENABLED
    depends on ZMK_POINTING_SMOOTH_SCROLLING

config ZMK_BB9900_USB_SUSPEND_IS_UNPLUGGED_DELAY_MS
    int "Milliseconds of USB suspend before treating it as unplugged"
    default 5000
    depends on ZMK_BB9900_USB_SUSPEND_IS_UNPLUGGED

config ZMK_BB9900_SLEEP_DIAG
    bool "Log deep sleep diagnostics (debug builds)"
    depends on ZMK_SLEEP
    depends on PM_DEVICE
    depends on LOG
```

## boards/zitaotech/bb9900/Kconfig.bb9900
```kconfig
# Copyright (c) 2023 ZitaoTech
# SPDX-License-Identifier: MIT

config BOARD_BB9900
    select SOC_NRF52840_QIAA
    select ZMK_BOARD_COMPAT if BOARD_BB9900_NRF52840_ZMK
    imply RETAINED_MEM if BOARD_BB9900_NRF52840_ZMK
    imply RETENTION if BOARD_BB9900_NRF52840_ZMK
    imply RETENTION_BOOT_MODE if BOARD_BB9900_NRF52840_ZMK
```

## boards/zitaotech/bb9900/board.yml
```yaml
board:
  name: bb9900
  full_name: BB9900 USB/BLE Keyboard
  vendor: zitaotech
  socs:
    - name: nrf52840
      variants:
        - name: zmk
```

## drivers/input/Kconfig
```kconfig
# SPDX-License-Identifier: MIT

config INPUT_A320
    bool "Avago ADBS-A320 optical finger navigation sensor"
    default y
    depends on DT_HAS_AVAGO_A320_ENABLED
    depends on INPUT
    select I2C
    help
      Polling input driver for the ADBS-A320 optical trackpad used in the
      BlackBerry 9900 and similar devices.
```

## dts/bindings/behaviors/zitaotech,behavior-scroll-resolution.yaml
```yaml
# SPDX-License-Identifier: MIT

description: |
  Toggles between smooth (high-resolution) and whole-notch scrolling for the currently selected
  output (USB or one BLE profile). The choice is saved per output. Use whole notches for hosts
  that do not support high-resolution scrolling, such as iOS and macOS.

compatible: "zitaotech,behavior-scroll-resolution"

include: zero_param.yaml
```

## dts/bindings/input/avago,a320.yaml
```yaml
# SPDX-License-Identifier: MIT

description: |
  Avago ADBS-A320 optical finger navigation sensor, as used for the BlackBerry 9900 trackpad.
  Reports relative X/Y motion through the Zephyr input subsystem.

compatible: "avago,a320"

include: i2c-device.yaml

properties:
  polling-interval-ms:
    type: int
    default: 10
    description: How often to poll the motion register while the finger is not moving.
  motion-polling-interval-ms:
    type: int
    default: 4
    description: |
      How often to poll while the finger is moving. The sensor produces a new sample about
      every 6 ms, so polling much faster than this gains nothing.
  motion-timeout-ms:
    type: int
    default: 100
    description: How long after the last motion to keep polling at the motion rate.
  idle-polling-interval-ms:
    type: int
    default: 25
    description: |
      How often to poll once the finger has been still for idle-timeout-ms. The first movement
      after a pause can lag by up to this much.
  idle-timeout-ms:
    type: int
    default: 1000
    description: How long without motion before dropping to the idle polling rate.
  ext-power:
    type: phandle
    description: |
      External power control that supplies the sensor. Used to power cycle the sensor when it
      stops responding, which also turns it back on if it was left off.
  speed-switching:
    type: boolean
    description: |
      Let the sensor switch resolution with finger speed (250 to 1000 CPI), which acts as
      built-in pointer acceleration. Off from reset; the datasheet power-up sequence enables it.
  high-cpi:
    type: boolean
    description: Allow speed switching to reach 1250 CPI instead of 1000 CPI.
  speed-check-interval-ms:
    type: int
    default: 8
    enum: [4, 8, 12, 16]
    description: How often the sensor re-evaluates finger speed for speed switching.
  speed-thresholds:
    type: uint8-array
    description: |
      Speed switching thresholds, written to OFN_Speed_ST12 through OFN_Speed_ST54 in this order:
      ST12 ST21 ST23 ST32 ST34 ST43 ST45 ST54. Each value is inches per second times 8.
      Leave unset to keep the sensor defaults.
  liftoff-shutter-threshold:
    type: int
    default: 0
    description: |
      Drop small motion samples whose shutter value is above this, unless they continue a fast
      stroke in the same direction. The shutter time rises as the finger lifts off, and those last
      samples cause the cursor to twitch. 0 disables the filter.
  assert-deassert:
    type: boolean
    description: Gate motion on image quality, to reject noise when the finger lifts.
  finger-detect:
    type: boolean
    description: Only report motion while a finger is on the sensor.
```

## dts/bindings/input_processors/zitaotech,input-processor-indicator-scroll.yaml
```yaml
# SPDX-License-Identifier: MIT

description: |
  Turns relative X/Y motion into scroll wheel events while any of the given HID indicators
  (caps lock, scroll lock, ...) is reported on by the host. Motion is accumulated and turned
  into scroll steps at most once per interval, using the stepped speed curve from the original
  BB9900 firmware.

  Expects REL_Y before REL_X in each report, which is what you get from a driver that reports
  X then Y followed by an XY swap transform.

compatible: "zitaotech,input-processor-indicator-scroll"

include: ip_zero_param.yaml

properties:
  indicators:
    type: int
    required: true
    description: Bitmask of HID_INDICATOR_* values that enable scroll mode.
  interval-ms:
    type: int
    default: 30
    description: Minimum time between emitted scroll steps.
```

## dts/bindings/input_processors/zitaotech,input-processor-scroll-curve.yaml
```yaml
# SPDX-License-Identifier: MIT

description: |
  Turns relative X/Y pointer motion into scroll wheel motion through a two-segment curve:
  the first knee counts of each sample scroll at low-gain, anything beyond at high-gain. A high
  low-gain keeps slow scrolling responsive; a low high-gain stops fast swipes from flinging the
  page, since speed switching already raises the sensor CPI on fast swipes.

  Gains are in 1/16 of a high-resolution scroll unit per count, where 16 high-resolution units
  make one wheel notch. With CONFIG_ZMK_POINTING_SMOOTH_SCROLLING off, output is whole notches
  and the remainder carries over.

  Scrolls like a wheel: finger down scrolls the view down, finger right scrolls it right. Turn
  on natural scrolling on the host to reverse both.

compatible: "zitaotech,input-processor-scroll-curve"

include: ip_zero_param.yaml

properties:
  knee:
    type: int
    default: 6
    description: Counts per sample scrolled at low-gain before switching to high-gain.
  low-gain:
    type: int
    default: 34
    description: Gain below the knee, in 1/16 high-resolution units per count.
  high-gain:
    type: int
    default: 3
    description: Gain above the knee, in 1/16 high-resolution units per count.
```

## config/west.yml
```yaml
manifest:
  remotes:
    - name: zmkfirmware
      url-base: https://github.com/zmkfirmware
  projects:
    - name: zmk
      remote: zmkfirmware
      revision: 4de313367288aad5aeaa1243890e40dc813f7008  # main
      import: app/west.yml
  self:
    path: config
```
